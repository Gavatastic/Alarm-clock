//  BSS138 mosfets
// Breshanen line drawing


#include <asf.h>
#include <I2C.h>
#include <SSD1306.h>
#include <framebuffer.h>
#include <TPIC6B595.h>


/*
Keyboard mapping

Flow from Row pins to Col pins

*/

const uint8_t KeyRowPins[4] = {PIN_PB07,PIN_PB06,PIN_PB05,PIN_PB04,};
const uint8_t KeyColPins[4] = {PIN_PB03,PIN_PB02,PIN_PB01,PIN_PB00,};


const uint8_t Atomic []  = {
	0x00, 0x00, 0x00, 0x07, 0xC0, 0x00, 0x00, 0x00, 0x00, 0x00, 0x00, 0x0F, 0xF0, 0x00, 0x00, 0x00,
	0x00, 0x00, 0x00, 0x3C, 0x38, 0x00, 0x00, 0x00, 0x00, 0x00, 0x00, 0x70, 0x1C, 0x00, 0x00, 0x00,
	0x00, 0x00, 0x00, 0x60, 0x0E, 0x00, 0x00, 0x00, 0x00, 0x00, 0x00, 0xE0, 0x07, 0x00, 0x00, 0x00,
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	0x00, 0x00, 0x00, 0x0F, 0xF0, 0x00, 0x00, 0x00, 0x00, 0x00, 0x00, 0x07, 0xC0, 0x00, 0x00, 0x00
};

uint8_t fb[SSD1306_BUFFERSIZE];
uint8_t ss[4];

void configure_port_pins(void)
{
	struct port_config config_port_pin;
	
	// Inputs
	for (uint8_t i=0; i<4; i++) 
	{
		port_get_config_defaults(&config_port_pin);
		config_port_pin.direction  = PORT_PIN_DIR_INPUT;
		config_port_pin.input_pull = PORT_PIN_PULL_DOWN;
		port_pin_set_config(KeyColPins[i], &config_port_pin);
	}
	
	// Outputs
	for (uint8_t i=0; i<4; i++) 
	{
		config_port_pin.direction = PORT_PIN_DIR_OUTPUT;
		port_pin_set_config(KeyRowPins[i], &config_port_pin);
	}

}


uint8_t IdentifyButton(uint8_t row, uint8_t col)
{

	switch (col)
	{
		case PIN_PB00:
		switch (row)
		{
			case PIN_PB04:
			return 1;
			break;
			case PIN_PB05:
			return 4;
			break;
			case PIN_PB06:
			return 7;
			break;
		}
		break;

		case PIN_PB01:
		switch (row)
		{
			case PIN_PB04:
			return 2;
			break;
			case PIN_PB05:
			return 5;
			break;
			case PIN_PB06:
			return 8;
			break;
			case PIN_PB07:
			return 10;
			break;
		}
		break;
		
		case PIN_PB02:
		switch (row)
		{
			case PIN_PB04:
			return 3;
			break;
			case PIN_PB05:
			return 6;
			break;
			case PIN_PB06:
			return 9;
			break;
		}
		break;

		case PIN_PB03:
		switch (row)
		{
			case PIN_PB04:
			return 11;
			break;
			case PIN_PB05:
			return 12;
			break;
			case PIN_PB06:
			return 13;
			break;
			case PIN_PB07:
			return 14;
			break;
		}
		break;
		
		
	}
	
	return 15;
}



int main (void)
{
	uint16_t buttons;

	uint8_t brightness=0x7F;
	
	
	system_init();
	delay_init();
	ioport_init();
	configure_port_pins();

	shftreg_init();
	shftreg_blank();
	shftreg_blank();
	

    configure_i2c_master();
	SSD1306_init();
  
	buffer_clear(fb);
	buffer_drawBitmap(fb, Atomic,64,64,32,0);
	SSD1306_send_buffer(fb);
	
	delay_s(1);
  
	buffer_clear(fb);
	buffer_drawButtonOutlines(fb);
	SSD1306_send_buffer(fb);

	// Test seven segment display
	ss[0]=1;
	ss[1]=2;
	ss[2]=3;
	ss[3]=4;

	shftreg_display(ss);    

	while(1==1)
	{

		buttons=0;
		for(uint8_t i=0; i<4; i++)
		{
			port_pin_set_output_level(KeyRowPins[i], true);
			for(uint8_t j=0; j<4; j++)			
			{
				if(port_pin_get_input_level(KeyColPins[j])) 
				{
					buttons=buttons + (1<<(IdentifyButton(KeyRowPins[i],KeyColPins[j])-1));
				}
			}
			port_pin_set_output_level(KeyRowPins[i], false);
		}
		buffer_drawButtonStates(fb,buttons);
		SSD1306_send_buffer(fb);
		
		if (buttons & (1<<12) || buttons & (1<<13))
		{
			if (buttons & (1<<12)) brightness+=4;
			if (buttons & (1<<13)) brightness-=4;
			shftreg_bright(brightness);
			ss[0]=brightness>>4;
			ss[2]=brightness>>4;
			ss[1]=brightness & 0x0f;
			ss[3]=brightness & 0x0f;
			shftreg_display(ss);		
			
		}

		
	}
	
}
